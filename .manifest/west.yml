## .manifest/west.yml
```yaml
manifest:
  projects:
    - name: zephyr
      url: https://github.com/zephyrproject-rtos/zephyr
      revision: v4.4.0
      west-commands: scripts/west-commands.yml
      import:
        name-allowlist:
          - cmsis
          - hal_stm32
  self:
    path: .manifest
```

## boards/clubrobot/carte26/Kconfig.carte26
```kconfig
# Copyright (c) 2020 Alexander Kozhinov <ak.alexander.kozhinov@gmail.com>
# SPDX-License-Identifier: Apache-2.0

config BOARD_CARTE26
	select SOC_STM32H723XX
```

## boards/clubrobot/carte26/board.yml
```yaml
board:
  name: carte26
  full_name: Carte Club Robot 26
  vendor: clubrobot
  socs:
    - name: stm32h723xx
```

## drivers/DRV8844/Kconfig
```kconfig
menuconfig DRV8844
    bool "DRV8844 driver support"
    help
        This option enables the driver support for the DRV8844

if DRV8844

config DRV8844_INIT_PRIORITY
    int "DRV8844 driver init priority"
    default KERNEL_INIT_PRIORITY_DEVICE
    help
        DRV8844 driver initialisation priority

config DRV8844_PWM_PERIOD
    int "DRV8844 PWM period (ns)"
    default 30000
    help
        DRV8844 PWM frequency in nanoseconds

module = DRV8844
module-str = DRV8844
source "subsys/logging/Kconfig.template.log_config"

endif
```

## drivers/DRV8876/Kconfig
```kconfig
menuconfig DRV8876
    bool "DRV8876 driver support"
    help
        This option enables the driver support for the DRV8876

if DRV8876

config DRV8876_INIT_PRIORITY
    int "DRV8876 driver init priority"
    default KERNEL_INIT_PRIORITY_DEVICE
    help
        DRV8876 driver initialisation priority

module = DRV8876
module-str = DRV8876
source "subsys/logging/Kconfig.template.log_config"

endif
```

## dts/bindings/motors/DRV8844.yaml
```yaml
# Créé par Awing le 21/10/2026
# SPDX-License-Identifier: AGPL-3.0

description: |
  Binding pour le DRV8844 contrôlant les moteurs.
  
  
compatible: "drv8844"
include: "base.yaml"

properties:
  sleep-gpios:
    type: phandle-array
    required: true
    description: Le pin de sleep du driver

  fault-gpios:
    type: phandle-array
    required: true
    description: Le pin de fault du driver

  channel-count:
    type: int
    required: false
    default: 1
    description: The number of active channel

child-binding:
  description: Motor channel configuration
  properties:
    reg:
      type: int
      required: true
      description: Channel index in the parent motor driver node

    enable-gpios:
      type: phandle-array
      required: true
      description: Enable GPIO for this motor channel

    pwms:
      type: phandle-array
      required: true
      description: PWM output for this motor channel

    dir-gpios:
      type: phandle-array
      required: true
      description: Direction GPIO for this motor channel
```

## dts/bindings/motors/DRV8876.yaml
```yaml
# Créé par Awing le 21/10/2026
# SPDX-License-Identifier: AGPL-3.0

description: |
  Binding pour le DRV8876 contrôlant les moteurs.
  
  
compatible: "drv8876"
include: "base.yaml"

properties:
  gpio-pwm:
    type: phandle
    required: true
    description: Le pin PWM du driver

  gpio-dir:
    type: phandle
    required: true
    description: Le pin de direction du driver

  gpio-sleep:
    type: phandle
    required: true
    description: Le pin de sleep du driver

  gpio-fault:
    type: phandle
    required: true
    description: Le pin de fault du driver
```

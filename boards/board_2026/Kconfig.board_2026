## boards/board_2026/board.yml
```yaml
board:
  name: board_2026
  full_name: Main Board 2026
  socs:
    - name: stm32h723xx
```

## drivers/motors/DRV8844/Kconfig
```kconfig
# SPDX-License-Identifier: AGPL-3.0

menuconfig DRV8844
    bool "DRV8844 driver support"
    help
        This option enables the driver support for the DRV8844

if DRV8844

config DRV8844_INIT_PRIORITY
    int "DRV8844 driver init priority"
    default KERNEL_INIT_PRIORITY_DEVICE
    help
        DRV8844 driver initialisation priority

config DRV8844_PWM_PERIOD
    int "DRV8844 PWM period (ns)"
    default 30000
    help
        DRV8844 PWM frequency in nanoseconds

config DRV8844_MAX_PWM
    int "DRV8844 maximum PWM value (in %)"
    default 100
    help
        DRV8844 maximum PWM value in % e.g. 50 means 50% duty cycle

module = DRV8844
module-str = DRV8844
source "subsys/logging/Kconfig.template.log_config"

endif
```

## drivers/motors/Kconfig
```kconfig
# SPDX-License-Identifier: AGPL-3.0

menuconfig MOTORS
    bool "Enable motor support"
    help
        This enable the support for all motor drivers

if MOTORS
rsource "DRV8844/Kconfig"
endif # MOTORS
```

## drivers/sensor/beacon/Kconfig
```kconfig
menuconfig BEACON_SENSOR
	bool "Beacon Sensor to detect the other robot"
	default y
	depends on DT_HAS_BEACON_TRACKER_ENABLED
	select GPIO
	select I2C
	help
	  Enable beacon sensor

config BEACON_MAX_I2C_CHUNK_SIZE
	int "Maximum I2C chunk size allowed"
	default 32
	depends on BEACON_SENSOR
	help
	  Allow to limit the size of each i2c chunk.

config BEACON_REFLECTANCE_THRESHOLD
    int "Minimum reflectance for a zone to be a beacon candidate (0-127)"
    range 0 127
    default 127
    depends on BEACON_SENSOR

config BEACON_MAX_DISTANCE
    int "Maximum distance in mm for a zone to be a beacon candidate"
    default 4000
    range 0 4000
    depends on BEACON_SENSOR
```

## dts/bindings/sensor/beacon-tracker.yaml
```yaml
description: |
  Reflective Beacon Tracker.
  A ring of 8 VL53L5CX (one every 45 degrees) powered on one by one through a
  74HC595-style shift register. Reports distance and bearing of the closest
  highly reflective target.


compatible: "beacon-tracker"

include: sensor-device.yaml

properties:
  i2c-bus:
    type: phandle
    required: true
    description: I2C bus shared by the 8 sensors.

  addresses:
    type: array
    required: true
    description: |
      The 8 I2C addresses (7 bit) assigned to the sensors.
      Must be unique and must not contain 0x29 (VL53L5CX default address).

  stcp-gpios:
    type: phandle-array
    required: true
    description: Storage register clock (RCLK / latch) of the shift register.

  shcp-gpios:
    type: phandle-array
    required: true
    description: Shift register clock (SRCLK) of the shift register.

  ds-gpios:
    type: phandle-array
    required: true
    description: Serial data input (SER) of the shift register.
```
